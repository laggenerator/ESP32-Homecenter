## components/mqtt_handler/Kconfig
```kconfig
menu "MQTT Config"
    config BROKER_URL
        string "Broker URL"
        default ""
        help
            URL brokera MQTT

    config MQTT_USERNAME
        string "Nazwa uzytkownika MQTT"
        default ""
        help
            Nazwa uzytkownika do autoryzacji MQTT (pozostaw puste jesli nie wymagane)

    config MQTT_PASSWORD
        string "Haslo MQTT"
        default ""
        help
            Haslo do autoryzacji MQTT (pozostaw puste jesli nie wymagane)

    config BROKER_URL_FROM_STDIN
        bool "Pobierz URL brokera z konsoli"
        default n
        help
            Jesli wlaczone, URL brokera bedzie pobierany z konsoli zamiast z konfiguracji
endmenu
```

## components/wifi/Kconfig
```kconfig
menu "WiFi STA Config"

    config WIFI_STA_CONNECT
        bool "Polacz sie z WiFi"
        default n
        help
            Wlacza driver WiFi aby pozwolic na polaczenie z siecia

    if WIFI_STA_CONNECT
        choice WIFI_STA_IP_TYPE
            prompt "Ktora wersja protokolu IP"
            default WIFI_STA_CONNECT_IPV4
            help
                Wybierz tryb polaczenia.
            config WIFI_STA_CONNECT_IPV4
                bool "IPv4"
                select LWIP_IPV4
                help
                    Uzyj jedynie IPv4.
            config WIFI_STA_CONNECT_IPV6
                bool "IPv6"
                select LWIP_IPV6
                help
                    Uzyj jedynie IPv6.
            config WIFI_STA_CONNECT_UNSPECIFIED
                bool "Either IPv4 or IPv6"
                select LWIP_IPV4
                select LWIP_IPV6
                help
                    Uzyj obojetnie ktorego.
        endchoice

        choice WIFI_STA_AUTH_MODE
            prompt "Minimum WiFi authentication mode"
            default WIFI_STA_AUTH_WPA2_PSK
            help
              Najslabsza wersja uwierzytelniania ktorej sprobuje ESP.
            config WIFI_STA_AUTH_OPEN
                bool "OPEN"
            config WIFI_STA_AUTH_WEP
                bool "WEP"
            config WIFI_STA_AUTH_WPA_PSK
                bool "WPA PSK"
            config WIFI_STA_AUTH_WPA2_PSK
                bool "WPA2 PSK"
            config WIFI_STA_AUTH_WPA_WPA2_PSK
                bool "WPA/WPA2 PSK"
            config WIFI_STA_AUTH_WPA3_PSK
                bool "WPA3 PSK"
            config WIFI_STA_AUTH_WPA2_WPA3_PSK
                bool "WPA2/WPA3 PSK"
            config WIFI_STA_AUTH_WAPI_PSK
                bool "WAPI PSK"
        endchoice

        config WIFI_STA_SSID
            string "WiFi SSID"
            default "Twoj SSID"
            help
                Nazwa sieci z ktora ma sie laczyc

        config WIFI_STA_PASSWORD
            string "WiFi password"
            default "Twoje haslo"

        choice WIFI_STA_WPA3_SAE_MODE
            prompt "SAE mode for WPA3"
            default WIFI_STA_WPA3_SAE_PWE_BOTH
            help
                Select SAE mode as Hunt and Peck, H2E, or both.
            config WIFI_STA_WPA3_SAE_PWE_HUNT_AND_PECK
                bool "Hunt and Peck"
            config WIFI_STA_WPA3_SAE_PWE_H2E
                bool "Hash to Element (H2E)"
            config WIFI_STA_WPA3_SAE_PWE_BOTH
                bool "Both"
        endchoice

        config WIFI_STA_WPA3_PASSWORD_ID
            string "Password identifier for SAE H2E"
            depends on WIFI_STA_WPA3_SAE_PWE_H2E || WIFI_STA_WPA3_SAE_PWE_BOTH
            default ""
            help
                Password identifier for SAE H2E mode.

        config WIFI_STA_AUTO_RECONNECT
            bool "Automatycznie probuj polaczyc sie z powrotem"
            default n
            help
              Automatycznie laczy sie z powrotem po rozlaczeniu.

    endif
endmenu
```

## main/Kconfig.projbuild
```kconfig
menu "Ustawienia MQTT"
  config BROKER_URL
    string "Broker URL"
    default ""
    help
      URL brokera MQTT

  config MQTT_USERNAME
    string "Nazwa uzytkownika MQTT"
    default ""
    help
      Nazwa uzytkownika do autoryzacji MQTT (pozostaw puste jesli nie wymagane)

  config MQTT_PASSWORD
    string "Haslo MQTT"
    default ""
    help
      Haslo do autoryzacji MQTT (pozostaw puste jesli nie wymagane)

  config BROKER_URL_FROM_STDIN
    bool "Pobierz URL brokera z konsoli"
    default n
    help
      Jesli wlaczone, URL brokera bedzie pobierany z konsoli zamiast z konfiguracji

  config MQTT_NAZWA_RODZINY
    string "Rodzina MQTT"
    default "zmienmnie"
    help
      Ustaw rodzinę MQTT aby obsługiwać swoje urządzenia

  config MQTT_KANAL_KEEPALIVE
    string "Temat MQTT do przesyłania keepAlive"
    default "status"
    help
      Ustaw temat do przesyłania keep-alive do brokera.
      Pełny temat to: rodzina/tematkeepalive

  config MQTT_NAZWA_URZADZENIA
    string "Nazwa urzadzenia do identyfikacji"
    default "zmienmnie"
    help
      Ustaw nazwę urządzenia, aby wiedzieć na co reagować

  config MQTT_MASTER
    bool "1 = master, 0 = slave"
    default n
    help
      Ustaw typ urządzenia.
      1 = master, 0 = slave

endmenu

menu "Ustawienia RXB6"
  config RXB6_USED
    bool "Czy RXB6 jest podłączone"
    default n
    help
      Wybierz czy urządzenie wykorzystuje RXB6

  if RXB6_USED
    config RXB6_GPIO_NUM
      int "RXB6 GPIO"
      default -1
      help
        Pin do którego podłączono RXB6

    config RXB6_DEBOUNCE_TIME
      int "Czas debounce inputu w ms"
      default 50
      help
        Minimalny czas pomiędzy rejestrowaniem dwóch kodów
    config RXB6_LOG_LEVEL
      int "Log level"
      range 0 5
      default 3
      help
        0 - Brak logów
        1 - Błędy (Error)
        2 - Ostrzeżenia (Warning) 
        3 - Informacje (Info)
        4 - Debug
        5 - Verbose
  endif
endmenu

menu "Rysunkowicz"
  config RYSUNKOWICZ_ENABLE
  bool "Uzywac rysunkowicz?"
  default n

  if RYSUNKOWICZ_ENABLE
    config RYSUNKOWICZ_URL
      string "URL rysunkowicza"
      default "http://rysunkowicz.pwrowicz.pl/"
    config RYSUNKOWICZ_ENDPOINT
      string "Endpoint bitmapy"
      default "bitmapa"

    config RYSUNKOWICZ_LOG_LEVEL
      int "Log level"
      range 0 5
      default 3
      help
        0 - Brak logów
        1 - Błędy (Error)
        2 - Ostrzeżenia (Warning) 
        3 - Informacje (Info)
        4 - Debug
        5 - Verbose
  endif
endmenu
```
